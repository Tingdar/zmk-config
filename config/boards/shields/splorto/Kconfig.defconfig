## config/boards/shields/splorto/Kconfig.defconfig
```kconfig
if SHIELD_SPLORTO_LEFT

config ZMK_KEYBOARD_NAME
    default "Splorto"

config ZMK_SPLIT_ROLE_CENTRAL
    default y

endif # SHIELD_SPLORTO_LEFT

if SHIELD_SPLORTO_LEFT || SHIELD_SPLORTO_RIGHT

config ZMK_SPLIT
    default y

endif # SHIELD_SPLORTO_LEFT || SHIELD_SPLORTO_RIGHT
```

## config/boards/shields/splorto/Kconfig.shield
```kconfig
config SHIELD_SPLORTO_LEFT
    def_bool $(shields_list_contains,splorto_left)

config SHIELD_SPLORTO_RIGHT
    def_bool $(shields_list_contains,splorto_right)
```
